## src/modules/aviant/Kconfig
```kconfig
menu "AVIANT"
	menuconfig MODULES_AVIANT
		bool "Aviant specific features"
		default y
		---help---
			Enable Aviant specific features

	rsource "*/Kconfig"
endmenu
```

## src/modules/aviant/ats/Kconfig
```kconfig
menuconfig MODULES_AVIANT_ATS
	bool "Aviant ATS"
	default n
	help
		Enable Aviant ATS (Automatic Trigger System)
```
